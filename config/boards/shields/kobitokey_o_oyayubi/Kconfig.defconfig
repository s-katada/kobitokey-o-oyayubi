## config/boards/shields/kobitokey_o_oyayubi/Kconfig.defconfig
```kconfig
if SHIELD_KOBITOKEY_O_OYAYUBI_LEFT

config ZMK_KEYBOARD_NAME
    default "kobitokey-o-oyayubi"

endif

if SHIELD_KOBITOKEY_O_OYAYUBI_LEFT || SHIELD_KOBITOKEY_O_OYAYUBI_RIGHT

config ZMK_SPLIT
    default y

config ZMK_POINTING
    default y

config SPI
    default y

endif
```

## firmware-zmk/config/boards/shields/kobitokey_o_oyayubi/Kconfig.defconfig
```kconfig
if SHIELD_KOBITOKEY_O_OYAYUBI_LEFT

config ZMK_KEYBOARD_NAME
    default "kobitokey-o-oyayubi"

config ZMK_SPLIT_ROLE_CENTRAL
    default y

endif

if SHIELD_KOBITOKEY_O_OYAYUBI_LEFT || SHIELD_KOBITOKEY_O_OYAYUBI_RIGHT

config ZMK_SPLIT
    default y

config ZMK_SPLIT_BLE
    default y

# Free P0_09 / P0_10 so they can drive the trackball CS and matrix COL4.
config NFCT_PINS_AS_GPIOS
    default y

config SPI
    default y

config INPUT
    default y

config ZMK_POINTING
    default y

config PMW3610_ALT
    default y

endif
```

## firmware-zmk/config/boards/shields/kobitokey_o_oyayubi/Kconfig.shield
```kconfig
config SHIELD_KOBITOKEY_O_OYAYUBI_LEFT
    def_bool $(shields_list_contains,kobitokey_o_oyayubi_left)

config SHIELD_KOBITOKEY_O_OYAYUBI_RIGHT
    def_bool $(shields_list_contains,kobitokey_o_oyayubi_right)
```
